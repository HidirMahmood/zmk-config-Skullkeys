## config/boards/shields/Skullkeys/Kconfig.defconfig
```kconfig
if SHIELD_SKULLKEYS_LEFT

config ZMK_KEYBOARD_NAME
    default "skullkeys"

config ZMK_SPLIT_ROLE_CENTRAL
    default y

endif

if SHIELD_SKULLKEYS_LEFT || SHIELD_SKULLKEYS_RIGHT

config ZMK_SPLIT
    default y

endif 
```

## config/boards/shields/Skullkeys/Kconfig.shield
```kconfig
# Copyright (c) 2020 Pete Johanson
# SPDX-License-Identifier: MIT

# No whitespace after the comma or in your part name!
config SHIELD_SKULLKEYS_LEFT
    def_bool $(shields_list_contains,skullkeys_left)

# No whitespace after the comma or in your part name!
config SHIELD_SKULLKEYS_RIGHT
    def_bool $(shields_list_contains,skullkeys_right)
```
